## drivers/sensor/am2320/Kconfig
```kconfig
config AM2320
    bool "ASAIR AM2320 Temperature and Humidity I2C sensor"
    default y
    select I2C
    
config AM2320_DO_CRC
    bool "Enable CRC check for AM2320 sensor readings"
    default y
    help
        If enabled, the driver will perform a CRC check on the sensor readings to verify data integrity.
```

## west.yml
```yaml
# Copyright (c) 2021 Nordic Semiconductor ASA
# SPDX-License-Identifier: Apache-2.0

manifest:
  remotes:
    - name: zephyrproject
      url-base: https://github.com/zephyrproject-rtos
    - name: conn-mgr
      url-base: https://github.com/Naquino14

  projects:
    - name: zephyr
      repo-path: zephyr
      remote: zephyrproject
      revision: v4.4.2
      import:
        name-allowlist:
          - hal_espressif
          - mbedtls
          - tf-psa-crypto
      clone-depth: 1
    - name: conn-mgr
      repo-path: conn-mgr
      remote: conn-mgr
      revision: master

  self:
    path: hot-or-not
```
